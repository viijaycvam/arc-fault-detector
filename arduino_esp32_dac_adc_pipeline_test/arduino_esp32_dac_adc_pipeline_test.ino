#include <Arduino.h>
#include <math.h>

#include "driver/adc.h"
#include "esp_adc/adc_continuous.h"
#include "esp_err.h"
#include "soc/soc_caps.h"

#include "freertos/FreeRTOS.h"
#include "freertos/task.h"

extern "C" {
#include "feature_extraction.h"
}

#include "tinyml_engine_b.h"


#ifndef M_PI
#define M_PI 3.14159265358979323846
#endif


// ============================================================
// ESP32 DAC -> ADC -> ROBUST CYCLE -> 8 FEATURES -> MLP
//
// HARDWARE-IN-THE-LOOP SAFE TEST
//
// DAC:
//   GPIO25
//
// ADC:
//   GPIO34 = ADC1_CH6
//
// CONNECTION:
//   GPIO25 (D25) -> GPIO34 (D34)
//
// IMPORTANT:
//   Connect the D25 -> D34 jumper ONLY after the sketch has
//   uploaded successfully and the ESP32 is powered off.
//
// Waveform:
//   50 Hz sine-like waveform
//   generated by the internal ESP32 DAC.
//
// DAC update rate:
//   1000 updates/sec
//
// ADC:
//   50 kHz continuous DMA
//
// Processing:
//   ADC samples
//      |
//      +--> DC removal
//      |
//      +--> normalized low-pass timing signal
//      |
//      +--> hysteresis crossing detection
//      |
//      +--> raw-cycle resampling
//      |
//      +--> 8 verified features
//      |
//      +--> verified MLP
//
// NO MAINS.
// ============================================================


// ------------------------------------------------------------
// DAC configuration
// ------------------------------------------------------------

#define DAC_PIN                 25

#define DAC_UPDATE_HZ           1000
#define DAC_WAVEFORM_HZ         50.0f

// DAC midpoint and amplitude.
//
// Keep the generated waveform comfortably inside the 0..255
// DAC code range.
//
// 128 +/- 70
// gives approximately:
//
//   minimum = 58
//   maximum = 198
//
// on the 8-bit DAC code scale.
// ------------------------------------------------------------

#define DAC_MIDPOINT            128.0f
#define DAC_AMPLITUDE           70.0f


// ------------------------------------------------------------
// ADC configuration
// ------------------------------------------------------------

#define ADC_PIN                 34
#define ADC_CHANNEL             ADC_CHANNEL_6

#define SAMPLE_RATE_HZ          50000
#define ACQUISITION_SAMPLES     5000
#define FRAME_BYTES             256


// ------------------------------------------------------------
// Cycle slicing
// ------------------------------------------------------------

#define TARGET_CYCLE_LEN        1000
#define MAX_CROSSINGS           16

#define LOWPASS_CUTOFF_HZ       100.0f
#define HYSTERESIS              0.10f

#define MIN_CROSSING_INTERVAL   700.0f


// ------------------------------------------------------------
// Buffers
// ------------------------------------------------------------

static uint16_t adc_samples[
    ACQUISITION_SAMPLES
];

static float resampled_cycle[
    TARGET_CYCLE_LEN
];

static float crossing_positions[
    MAX_CROSSINGS
];


// ------------------------------------------------------------
// ADC handle
// ------------------------------------------------------------

static adc_continuous_handle_t adc_handle =
    NULL;


// ------------------------------------------------------------
// DAC task control
// ------------------------------------------------------------

static volatile bool waveform_running =
    false;

static TaskHandle_t dac_task_handle =
    NULL;


// ------------------------------------------------------------
// DAC waveform generator task
// ------------------------------------------------------------

static void dac_waveform_task(
    void *parameter
)
{
    (void)parameter;

    uint32_t sample_index =
        0;

    const float phase_step =
        2.0f *
        (float)M_PI *
        DAC_WAVEFORM_HZ /
        (float)DAC_UPDATE_HZ;


    // Start from midpoint.
    dacWrite(
        DAC_PIN,
        (int)DAC_MIDPOINT
    );


    while (waveform_running)
    {
        float phase =
            phase_step *
            (float)sample_index;


        float sine_value =
            sinf(phase);


        float dac_value =
            DAC_MIDPOINT +
            DAC_AMPLITUDE *
            sine_value;


        if (dac_value < 0.0f)
        {
            dac_value = 0.0f;
        }


        if (dac_value > 255.0f)
        {
            dac_value = 255.0f;
        }


        dacWrite(
            DAC_PIN,
            (uint8_t)dac_value
        );


        sample_index++;


        // Keep the DAC update approximately at 1 kHz.
        vTaskDelay(
            pdMS_TO_TICKS(1)
        );
    }


    dacWrite(
        DAC_PIN,
        (uint8_t)DAC_MIDPOINT
    );


    dac_task_handle =
        NULL;


    vTaskDelete(NULL);
}


// ------------------------------------------------------------
// Start waveform generator
// ------------------------------------------------------------

static bool start_waveform()
{
    waveform_running =
        true;


    BaseType_t result =
        xTaskCreatePinnedToCore(
            dac_waveform_task,
            "DACWaveform",
            2048,
            NULL,
            1,
            &dac_task_handle,
            0
        );


    if (
        result !=
        pdPASS
    )
    {
        waveform_running =
            false;

        dac_task_handle =
            NULL;

        return false;
    }


    return true;
}


// ------------------------------------------------------------
// Stop waveform
// ------------------------------------------------------------

static void stop_waveform()
{
    waveform_running =
        false;


    // Give task time to stop.
    for (
        int i = 0;
        i < 20 &&
        dac_task_handle != NULL;
        i++
    )
    {
        delay(1);
    }


    dacWrite(
        DAC_PIN,
        (uint8_t)DAC_MIDPOINT
    );
}


// ------------------------------------------------------------
// Start ADC DMA
// ------------------------------------------------------------

static bool start_adc()
{
    adc_continuous_handle_cfg_t handle_config = {};

    handle_config.max_store_buf_size =
        8192;

    handle_config.conv_frame_size =
        FRAME_BYTES;


    esp_err_t err =
        adc_continuous_new_handle(
            &handle_config,
            &adc_handle
        );


    if (err != ESP_OK)
    {
        Serial.printf(
            "ERROR: ADC handle: 0x%X\n",
            err
        );

        adc_handle =
            NULL;

        return false;
    }


    adc_digi_pattern_config_t pattern = {};

    pattern.atten =
        ADC_ATTEN_DB_11;

    pattern.channel =
        ADC_CHANNEL;

    pattern.unit =
        ADC_UNIT_1;

    pattern.bit_width =
        ADC_BITWIDTH_12;


    adc_continuous_config_t config = {};

    config.sample_freq_hz =
        SAMPLE_RATE_HZ;

    config.conv_mode =
        ADC_CONV_SINGLE_UNIT_1;

    config.format =
        ADC_DIGI_OUTPUT_FORMAT_TYPE1;

    config.pattern_num =
        1;

    config.adc_pattern =
        &pattern;


    err =
        adc_continuous_config(
            adc_handle,
            &config
        );


    if (err != ESP_OK)
    {
        Serial.printf(
            "ERROR: ADC config: 0x%X\n",
            err
        );

        adc_continuous_deinit(
            adc_handle
        );

        adc_handle =
            NULL;

        return false;
    }


    err =
        adc_continuous_start(
            adc_handle
        );


    if (err != ESP_OK)
    {
        Serial.printf(
            "ERROR: ADC start: 0x%X\n",
            err
        );

        adc_continuous_deinit(
            adc_handle
        );

        adc_handle =
            NULL;

        return false;
    }


    return true;
}


// ------------------------------------------------------------
// Flush startup DMA data
// ------------------------------------------------------------

static void flush_startup_data()
{
    uint8_t dma_buffer[
        FRAME_BYTES
    ];


    while (true)
    {
        uint32_t bytes_read =
            0;


        esp_err_t err =
            adc_continuous_read(
                adc_handle,
                dma_buffer,
                sizeof(dma_buffer),
                &bytes_read,
                0
            );


        if (
            err ==
            ESP_ERR_TIMEOUT
        )
        {
            break;
        }


        if (
            err !=
            ESP_OK
        )
        {
            break;
        }
    }
}


// ------------------------------------------------------------
// Acquire exactly 5000 ADC samples
// ------------------------------------------------------------

static bool acquire_samples(
    uint32_t &elapsed_us
)
{
    uint8_t dma_buffer[
        FRAME_BYTES
    ];


    uint32_t sample_count =
        0;


    uint32_t start_us =
        micros();


    while (
        sample_count <
        ACQUISITION_SAMPLES
    )
    {
        uint32_t bytes_read =
            0;


        esp_err_t err =
            adc_continuous_read(
                adc_handle,
                dma_buffer,
                sizeof(dma_buffer),
                &bytes_read,
                100
            );


        if (
            err ==
            ESP_ERR_TIMEOUT
        )
        {
            continue;
        }


        if (
            err !=
            ESP_OK
        )
        {
            Serial.printf(
                "ERROR: ADC read: 0x%X\n",
                err
            );

            return false;
        }


        for (
            uint32_t i = 0;
            i + 1 < bytes_read &&
            sample_count <
                ACQUISITION_SAMPLES;
            i += 2
        )
        {
            uint16_t word =
                (
                    (uint16_t)
                    dma_buffer[i]
                )
                |
                (
                    (
                        (uint16_t)
                        dma_buffer[i + 1]
                    )
                    << 8
                );


            uint16_t channel =
                (
                    word >> 12
                )
                &
                0x0F;


            uint16_t raw =
                word &
                0x0FFF;


            if (
                channel ==
                ADC_CHANNEL
            )
            {
                adc_samples[
                    sample_count
                ] =
                    raw;

                sample_count++;
            }
        }
    }


    elapsed_us =
        micros() -
        start_us;


    return (
        sample_count ==
        ACQUISITION_SAMPLES
    );
}


// ------------------------------------------------------------
// Mean
// ------------------------------------------------------------

static float calculate_mean()
{
    uint64_t sum =
        0;


    for (
        int i = 0;
        i < ACQUISITION_SAMPLES;
        i++
    )
    {
        sum +=
            adc_samples[i];
    }


    return (
        (float)sum /
        (float)ACQUISITION_SAMPLES
    );
}


// ------------------------------------------------------------
// Signal scale
// ------------------------------------------------------------

static float calculate_signal_scale(
    float dc_mean
)
{
    float max_abs =
        0.0f;


    for (
        int i = 0;
        i < ACQUISITION_SAMPLES;
        i++
    )
    {
        float centered =
            (
                (float)adc_samples[i] -
                dc_mean
            );


        float magnitude =
            fabsf(centered);


        if (
            magnitude >
            max_abs
        )
        {
            max_abs =
                magnitude;
        }
    }


    if (
        max_abs <
        1e-6f
    )
    {
        max_abs =
            1.0f;
    }


    return max_abs;
}


// ------------------------------------------------------------
// Robust zero crossing
// ------------------------------------------------------------

static int detect_crossings(
    float dc_mean,
    float signal_scale
)
{
    int crossing_count =
        0;


    int state =
        0;


    float last_crossing =
        -1.0f;


    float dt =
        1.0f /
        (float)SAMPLE_RATE_HZ;


    float rc =
        1.0f /
        (
            2.0f *
            (float)M_PI *
            LOWPASS_CUTOFF_HZ
        );


    float alpha =
        dt /
        (rc + dt);


    float first_centered =
        (
            (
                (float)adc_samples[0]
                -
                dc_mean
            )
            /
            signal_scale
        );


    float previous_filtered =
        first_centered;


    for (
        int i = 1;
        i < ACQUISITION_SAMPLES;
        i++
    )
    {
        float centered =
            (
                (
                    (float)adc_samples[i]
                    -
                    dc_mean
                )
                /
                signal_scale
            );


        float current_filtered =
            previous_filtered
            +
            alpha *
            (
                centered
                -
                previous_filtered
            );


        float previous =
            previous_filtered;


        float current =
            current_filtered;


        if (
            state == 0
        )
        {
            if (
                current <=
                -HYSTERESIS
            )
            {
                state =
                    1;
            }
        }
        else
        {
            if (
                previous <
                HYSTERESIS
                &&
                current >=
                HYSTERESIS
            )
            {
                float denominator =
                    current -
                    previous;


                float crossing;


                if (
                    fabsf(
                        denominator
                    )
                    <
                    1e-15f
                )
                {
                    crossing =
                        (float)i;
                }
                else
                {
                    crossing =
                        (float)(i - 1)
                        +
                        (
                            (
                                HYSTERESIS
                                -
                                previous
                            )
                            /
                            denominator
                        );
                }


                if (
                    last_crossing <
                    0.0f
                    ||
                    (
                        crossing -
                        last_crossing
                    )
                    >=
                    MIN_CROSSING_INTERVAL
                )
                {
                    if (
                        crossing_count <
                        MAX_CROSSINGS
                    )
                    {
                        crossing_positions[
                            crossing_count
                        ] =
                            crossing;

                        crossing_count++;
                    }


                    last_crossing =
                        crossing;


                    state =
                        0;
                }
            }
        }


        previous_filtered =
            current_filtered;
    }


    return crossing_count;
}


// ------------------------------------------------------------
// Raw ADC interpolation
// ------------------------------------------------------------

static float interpolate_raw(
    float position,
    float dc_mean
)
{
    if (
        position <=
        0.0f
    )
    {
        return (
            (float)adc_samples[0]
            -
            dc_mean
        );
    }


    if (
        position >=
        (float)(
            ACQUISITION_SAMPLES -
            1
        )
    )
    {
        return (
            (
                (float)
                adc_samples[
                    ACQUISITION_SAMPLES -
                    1
                ]
            )
            -
            dc_mean
        );
    }


    int index =
        (int)floorf(
            position
        );


    float fraction =
        position -
        (float)index;


    float x0 =
        (
            (float)adc_samples[
                index
            ]
            -
            dc_mean
        );


    float x1 =
        (
            (float)adc_samples[
                index + 1
            ]
            -
            dc_mean
        );


    return (
        x0
        +
        fraction *
        (
            x1 -
            x0
        )
    );
}


// ------------------------------------------------------------
// Resample one raw cycle to exactly 1000 points
// ------------------------------------------------------------

static void resample_cycle(
    float start,
    float end,
    float dc_mean
)
{
    float span =
        end -
        start;


    for (
        int i = 0;
        i < TARGET_CYCLE_LEN;
        i++
    )
    {
        float position =
            start
            +
            (
                (float)i /
                (float)TARGET_CYCLE_LEN
            )
            *
            span;


        resampled_cycle[i] =
            interpolate_raw(
                position,
                dc_mean
            );
    }
}


// ------------------------------------------------------------
// Print ADC statistics
// ------------------------------------------------------------

static void print_adc_statistics(
    float dc_mean,
    float signal_scale
)
{
    uint16_t min_value =
        4095;

    uint16_t max_value =
        0;


    for (
        int i = 0;
        i < ACQUISITION_SAMPLES;
        i++
    )
    {
        if (
            adc_samples[i] <
            min_value
        )
        {
            min_value =
                adc_samples[i];
        }


        if (
            adc_samples[i] >
            max_value
        )
        {
            max_value =
                adc_samples[i];
        }
    }


    Serial.println();
    Serial.println(
        "ADC STATISTICS"
    );

    Serial.println(
        "----------------------------------------"
    );


    Serial.printf(
        "Samples            : %d\n",
        ACQUISITION_SAMPLES
    );


    Serial.printf(
        "Min ADC            : %u\n",
        min_value
    );


    Serial.printf(
        "Max ADC            : %u\n",
        max_value
    );


    Serial.printf(
        "Mean ADC           : %.3f\n",
        dc_mean
    );


    Serial.printf(
        "Peak centered ADC  : %.3f\n",
        signal_scale
    );
}


// ------------------------------------------------------------
// SETUP
// ------------------------------------------------------------

void setup()
{
    Serial.begin(
        115200
    );


    delay(
        1000
    );


    Serial.println();

    Serial.println(
        "=================================================="
    );

    Serial.println(
        "ESP32 DAC -> ADC -> CYCLE -> FEATURES -> MLP"
    );

    Serial.println(
        "=================================================="
    );


    Serial.printf(
        "Board              : DOIT ESP32 DEVKIT V1\n"
    );


    Serial.printf(
        "CPU frequency      : %d MHz\n",
        getCpuFrequencyMhz()
    );


    Serial.printf(
        "Arduino core       : %s\n",
        ESP_ARDUINO_VERSION_STR
    );


    Serial.printf(
        "ESP-IDF            : %s\n",
        esp_get_idf_version()
    );


    Serial.printf(
        "DAC output         : GPIO%d\n",
        DAC_PIN
    );


    Serial.printf(
        "DAC waveform       : %.1f Hz\n",
        DAC_WAVEFORM_HZ
    );


    Serial.printf(
        "DAC update rate    : %d Hz\n",
        DAC_UPDATE_HZ
    );


    Serial.printf(
        "ADC input          : GPIO%d\n",
        ADC_PIN
    );


    Serial.printf(
        "ADC rate           : %d Hz\n",
        SAMPLE_RATE_HZ
    );


    Serial.println();

    Serial.println(
        "Expected wiring:"
    );


    Serial.println(
        "D25 -> D34"
    );


    Serial.println();

    Serial.println(
        "NO MAINS."
    );


    // --------------------------------------------------------
    // Start waveform task.
    // --------------------------------------------------------

    if (
        !start_waveform()
    )
    {
        Serial.println(
            "STATUS: DAC TASK START FAILED"
        );

        while (true)
        {
            delay(1000);
        }
    }


    // Let waveform settle.
    delay(200);


    // --------------------------------------------------------
    // Start ADC.
    // --------------------------------------------------------

    if (
        !start_adc()
    )
    {
        stop_waveform();


        Serial.println(
            "STATUS: ADC START FAILED"
        );


        while (true)
        {
            delay(1000);
        }
    }


    Serial.println();
    Serial.println(
        "ADC DMA started."
    );


    // --------------------------------------------------------
    // Flush DMA startup data.
    // --------------------------------------------------------

    flush_startup_data();


    Serial.println(
        "Startup DMA data flushed."
    );


    // --------------------------------------------------------
    // Acquire 100 ms.
    // --------------------------------------------------------

    uint32_t acquisition_us =
        0;


    bool acquired =
        acquire_samples(
            acquisition_us
        );


    // Stop ADC.
    adc_continuous_stop(
        adc_handle
    );


    adc_continuous_deinit(
        adc_handle
    );


    adc_handle =
        NULL;


    // Stop DAC.
    stop_waveform();


    if (!acquired)
    {
        Serial.println();

        Serial.println(
            "STATUS: ADC ACQUISITION FAILED"
        );


        while (true)
        {
            delay(1000);
        }
    }


    // --------------------------------------------------------
    // ADC statistics.
    // --------------------------------------------------------

    float dc_mean =
        calculate_mean();


    float signal_scale =
        calculate_signal_scale(
            dc_mean
        );


    print_adc_statistics(
        dc_mean,
        signal_scale
    );


    float acquisition_ms =
        acquisition_us /
        1000.0f;


    float observed_rate =
        (
            (float)ACQUISITION_SAMPLES /
            (float)acquisition_us
        )
        *
        1000000.0f;


    Serial.println();

    Serial.println(
        "ACQUISITION"
    );

    Serial.println(
        "----------------------------------------"
    );


    Serial.printf(
        "Elapsed            : %.3f ms\n",
        acquisition_ms
    );


    Serial.printf(
        "Observed rate      : %.2f samples/sec\n",
        observed_rate
    );


    Serial.println(
        "Short-window rate is diagnostic only."
    );


    // --------------------------------------------------------
    // Cycle detection.
    // --------------------------------------------------------

    uint32_t slicer_start =
        micros();


    int crossing_count =
        detect_crossings(
            dc_mean,
            signal_scale
        );


    uint32_t slicer_end =
        micros();


    Serial.println();

    Serial.println(
        "CYCLE DETECTION"
    );

    Serial.println(
        "----------------------------------------"
    );


    Serial.printf(
        "Crossings detected : %d\n",
        crossing_count
    );


    Serial.printf(
        "Slicer time        : %lu us\n",
        (unsigned long)(
            slicer_end -
            slicer_start
        )
    );


    if (
        crossing_count <
        2
    )
    {
        Serial.println();

        Serial.println(
            "STATUS: NO COMPLETE CYCLE DETECTED"
        );


        Serial.println(
            "Check that D25 is physically connected"
        );


        Serial.println(
            "to D34 and the DAC is generating samples."
        );


        while (true)
        {
            delay(5000);
        }
    }


    // --------------------------------------------------------
    // First-cycle frequency.
    // --------------------------------------------------------

    float first_period =
        crossing_positions[1]
        -
        crossing_positions[0];


    float first_frequency =
        (float)SAMPLE_RATE_HZ /
        first_period;


    Serial.printf(
        "First period       : %.3f samples\n",
        first_period
    );


    Serial.printf(
        "First frequency    : %.6f Hz\n",
        first_frequency
    );


    // --------------------------------------------------------
    // Resample.
    // --------------------------------------------------------

    uint32_t resample_start =
        micros();


    resample_cycle(
        crossing_positions[0],
        crossing_positions[1],
        dc_mean
    );


    uint32_t resample_end =
        micros();


    // --------------------------------------------------------
    // Features.
    // --------------------------------------------------------

    float features[8];


    uint32_t dsp_start =
        micros();


    extract_features_8(
        resampled_cycle,
        features
    );


    uint32_t dsp_end =
        micros();


    // --------------------------------------------------------
    // MLP.
    // --------------------------------------------------------

    float probability =
        0.0f;


    uint32_t mlp_start =
        micros();


    int prediction =
        predict_arc_8(
            features,
            &probability
        );


    uint32_t mlp_end =
        micros();


    // --------------------------------------------------------
    // Display.
    // --------------------------------------------------------

    Serial.println();

    Serial.println(
        "RESAMPLED CYCLE"
    );

    Serial.println(
        "----------------------------------------"
    );


    Serial.printf(
        "Cycle length       : %d\n",
        TARGET_CYCLE_LEN
    );


    Serial.printf(
        "Resampling time    : %lu us\n",
        (unsigned long)(
            resample_end -
            resample_start
        )
    );


    Serial.println();

    Serial.println(
        "8 FEATURES"
    );

    Serial.println(
        "----------------------------------------"
    );


    Serial.printf(
        "crest              : %.8f\n",
        features[0]
    );


    Serial.printf(
        "skew               : %.8f\n",
        features[1]
    );


    Serial.printf(
        "kurt               : %.8f\n",
        features[2]
    );


    Serial.printf(
        "d1_ratio           : %.8f\n",
        features[3]
    );


    Serial.printf(
        "d2_ratio           : %.8f\n",
        features[4]
    );


    Serial.printf(
        "peak_asym          : %.8f\n",
        features[5]
    );


    Serial.printf(
        "energy_asym        : %.8f\n",
        features[6]
    );


    Serial.printf(
        "frac_small         : %.8f\n",
        features[7]
    );


    Serial.println();

    Serial.println(
        "MLP INFERENCE"
    );

    Serial.println(
        "----------------------------------------"
    );


    Serial.printf(
        "Arc probability    : %.8f\n",
        probability
    );


    Serial.printf(
        "Prediction         : %s\n",
        prediction
            ? "ARC"
            : "NORMAL"
    );


    Serial.println();

    Serial.println(
        "TIMING"
    );

    Serial.println(
        "----------------------------------------"
    );


    Serial.printf(
        "Slicer             : %lu us\n",
        (unsigned long)(
            slicer_end -
            slicer_start
        )
    );


    Serial.printf(
        "Resampling         : %lu us\n",
        (unsigned long)(
            resample_end -
            resample_start
        )
    );


    Serial.printf(
        "DSP                 : %lu us\n",
        (unsigned long)(
            dsp_end -
            dsp_start
        )
    );


    Serial.printf(
        "MLP                 : %lu us\n",
        (unsigned long)(
            mlp_end -
            mlp_start
        )
    );


    Serial.printf(
        "DSP + MLP           : %lu us\n",
        (unsigned long)(
            mlp_end -
            dsp_start
        )
    );


    // --------------------------------------------------------
    // Final status.
    // --------------------------------------------------------

    Serial.println();

    Serial.println(
        "=================================================="
    );


    if (
        first_frequency >= 49.0f &&
        first_frequency <= 51.0f
    )
    {
        Serial.println(
            "STATUS: 50 Hz CYCLE DETECTED"
        );
    }
    else
    {
        Serial.println(
            "STATUS: CYCLE FREQUENCY OUTSIDE EXPECTED RANGE"
        );
    }


    Serial.println(
        "STATUS: DAC -> ADC -> DSP -> MLP TEST COMPLETE"
    );


    Serial.println(
        "=================================================="
    );
}


void loop()
{
    delay(5000);
}